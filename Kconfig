## Kconfig
```kconfig
menu "esp-baresip configuration"

config BARESIPTHREAD_STACKSIZE
    int "Stacksize of baresip thread"
    range 0 16384
    default 16384
    help
        Stacksize of baresip thread

endmenu
```
